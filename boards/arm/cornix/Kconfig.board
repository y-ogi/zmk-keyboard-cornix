## boards/arm/cornix/Kconfig.board
```kconfig
# cornix board configuration

# Copyright (c) 2020 The ZMK Contributors
# SPDX-License-Identifier: MIT

config BOARD_CORNIX_LEFT
    bool "Cornix Left"
    depends on SOC_SERIES_NRF52X

config BOARD_CORNIX_RIGHT
    bool "Cornix Right"
    depends on SOC_SERIES_NRF52X

config BOARD_CORNIX_PH_LEFT
    bool "Cornix PH Left"
    depends on SOC_SERIES_NRF52X
```

## boards/arm/cornix/cornix_right_defconfig
```kconfig
# SPDX-License-Identifier: MIT

# Board
CONFIG_BOARD_CORNIX_RIGHT=y

# SoC
CONFIG_SOC_SERIES_NRF52X=y
CONFIG_SOC_NRF52840_QIAA=y

CONFIG_ADC_NRFX_SAADC=y

# Use pinctrl
CONFIG_PINCTRL=y

# enable GPIO
CONFIG_GPIO=y

CONFIG_USE_DT_CODE_PARTITION=y
CONFIG_BUILD_OUTPUT_UF2=y

CONFIG_MPU_ALLOW_FLASH_WRITE=y
CONFIG_NVS=y
CONFIG_SETTINGS_NVS=y
CONFIG_FLASH=y
CONFIG_FLASH_PAGE_LAYOUT=y
CONFIG_FLASH_MAP=y

# E73: no external 32kHz crystal, use RC oscillator
CONFIG_CLOCK_CONTROL_NRF_K32SRC_RC=y

CONFIG_ZMK_SPLIT=y

CONFIG_ZMK_BLE=y
CONFIG_ZMK_BLE_EXPERIMENTAL_CONN=y

# never output usb
CONFIG_ZMK_USB=n

CONFIG_INPUT=y

# RGB
#CONFIG_SPI=n
#CONFIG_ZMK_EXT_POWER=n

CONFIG_EC11=y
CONFIG_EC11_TRIGGER_GLOBAL_THREAD=y

# One-time bond clear to sync with left side (revert to n after first flash)
CONFIG_ZMK_BLE_CLEAR_BONDS_ON_START=y

# vim: set ft=kconfig:
```

## config/west.yml
```yaml
manifest:
  remotes:
    - name: cormoran
      url-base: https://github.com/cormoran
    - name: urob
      url-base: https://github.com/urob
  projects:
    - name: zmk
      remote: cormoran
      revision: v0.3-branch+dya
      import: app/west.yml
    - name: zmk-helpers
      remote: urob
      revision: main
    - name: zmk-module-ble-management
      remote: cormoran
      revision: main
    - name: zmk-module-battery-history
      remote: cormoran
      revision: main
    - name: zmk-module-settings-rpc
      remote: cormoran
      revision: main
  self:
    path: config
```
