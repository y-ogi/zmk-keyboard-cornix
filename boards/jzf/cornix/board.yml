## boards/jzf/cornix/board.yml
```yaml
boards:
  - name: cornix_left
    vendor: jzf
    socs:
      - name: nrf52840
    revision:
      format: major.minor.patch
      default: 1.0.0
      revisions:
        - name: 1.0.0
  - name: cornix_right
    vendor: jzf
    socs:
      - name: nrf52840
    revision:
      format: major.minor.patch
      default: 1.0.0
      revisions:
        - name: 1.0.0
  - name: cornix_ph_left
    vendor: jzf
    socs:
      - name: nrf52840
    revision:
      format: major.minor.patch
      default: 1.0.0
      revisions:
        - name: 1.0.0
```
